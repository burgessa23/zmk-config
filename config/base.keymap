#include <behaviors.dtsi>
#include <behaviors/num_word.dtsi> // requires auto-layer module
#include <dt-bindings/zmk/keys.h>
#ifdef CONFIG_WIRELESS
    #include <dt-bindings/zmk/bt.h>
    #define _BT_SEL_KEYS_ &bt BT_SEL 0 &bt BT_SEL 1 &bt BT_SEL 2 &bt BT_SEL 3 &bt BT_CLR
#else
    #define _BT_SEL_KEYS_ &trans &trans &trans &trans &trans
#endif
#include <behaviors/rgbled_widget.dtsi>
#include "zmk-helpers/helper.h"

#define DEF 0
/* #define COLEMAK 1 */
#define NAV 1
#define SYM 2
#define NUM 3
#define FN 4
#define SYS 5
#define MOUSE 6
#define AERO 7
#define SHIFTED 8

#define XXX &none
#define ___ &trans

/* Global settings */

#define QUICK_TAP_MS 175

&sk {  // sticky-key config
    release-after-ms = <900>;  // release after 0.9s
    quick-release;             // no double capitalization when rolling keys
};

&sl {  // sticky-layer config
    ignore-modifiers;          // allow chording sticky mods & layers
    release-after-ms = <4000>;
};

&lt {  // layer-tap config
    flavor = "balanced";
    tapping-term-ms = <200>;
    quick-tap-ms = <QUICK_TAP_MS>;
};

/* Homerow mods */

#define KEYS_L LT0 LT1 LT2 LT3 LT4 LM0 LM1 LM2 LM3 LM4 LB0 LB1 LB2 LB3 LB4 LB5  // left hand
#define KEYS_R RT0 RT1 RT2 RT3 RT4 RM0 RM1 RM2 RM3 RM4 RB0 RB1 RB2 RB3 RB4 RB5  // right hand
#ifndef LH2
    #define THUMBS LH1 LH0 RH0 RH1                                          // thumbs on 34 keys
#else
    #define THUMBS LH2 LH1 LH0 RH0 RH1 RH2                                  // thumbs on 36+ keys
#endif

#define MAKE_HRM(NAME, HOLD, TAP, TRIGGER_POS) \
    ZMK_HOLD_TAP(NAME, \
        flavor = "balanced"; \
        tapping-term-ms = <280>; \
        quick-tap-ms = <QUICK_TAP_MS>; \
        require-prior-idle-ms = <100>; \
        bindings = <HOLD>, <TAP>; \
        hold-trigger-key-positions = <TRIGGER_POS>; \
        hold-trigger-on-release; \
    )
MAKE_HRM(hml, &kp, &kp, KEYS_R THUMBS)  // left-hand HRMs
MAKE_HRM(s_hmr, &hmr_sshft, &kp, KEYS_L KEYS_R THUMBS)  // smart-shift HRMs
MAKE_HRM(hmr, &kp, &kp, KEYS_L THUMBS)  // right-hand HRMs

// HRM combo hack - workaround for lack of tap-only combos (ZMK issue #544)
#define ZMK_COMBO_8(NAME, TAP, KEYPOS, LAYERS, COMBO_TERM, COMBO_IDLE, HOLD, SIDE) \
    MAKE_HRM(hm_combo_ ## NAME, &kp, TAP, SIDE THUMBS) \
    ZMK_COMBO_6(NAME, &hm_combo_ ## NAME HOLD 0, KEYPOS, LAYERS, COMBO_TERM, COMBO_IDLE)


/* Homerow retro mods */

#define MAKE_RETRO_HRM(NAME, HOLD, TAP, RETRO, TRIGGER_POS) \
    ZMK_HOLD_TAP(NAME, \
         flavor = "balanced"; \
         tapping-term-ms = <280>; \
         quick-tap-ms = <175>; \
         require-prior-idle-ms = <150>; \
         bindings = <HOLD>, <TAP>; \
         retro-tap; \
         retro-tap-behavior = "key_press"; \
         retro-tap-param1 = <RETRO>; \
         hold-trigger-key-positions = <TRIGGER_POS>; \
         hold-trigger-on-release; \
     ) 

/* Tap: letter | Hold + key: HRM | Hold: number */
/* qwerty */
MAKE_RETRO_HRM(rhml_s, &kp, &kp, N4, KEYS_R THUMBS) 
MAKE_RETRO_HRM(rhml_d, &kp, &kp, N5, KEYS_R THUMBS) 
MAKE_RETRO_HRM(rhml_f, &kp, &kp, N6, KEYS_R THUMBS) 




/* Combos, leader key sequences, mouse emulation */

#include "mouse.dtsi"
#include "extra_behaviours.dtsi"
#include "combos.dtsi"  // must be sources after HRM-combo hack
#include "leader.dtsi"


/* Magic-shift & auto-layers */
// Tap: repeat after alpha, else sticky-shift |
// Shift + tap/ double-tap: caps-word | Hold: shift.
#define MAGIC_SHIFT &magic_shift LSHFT 0

ZMK_HOLD_TAP(magic_shift, bindings = <&kp>, <&magic_shift_tap>;
             flavor = "balanced"; tapping-term-ms = <200>;
             quick-tap-ms = <QUICK_TAP_MS>;)
ZMK_MOD_MORPH(magic_shift_tap, bindings = <&shift_repeat>, <&caps_word>;
              mods = <(MOD_LSFT)>;)



ZMK_ADAPTIVE_KEY(
    shift_repeat, bindings = <&sk LSHFT>;
    repeat {
      trigger-keys = <A B C D E F G H I J K L M N O P Q R S T U V W X Y Z>;
      bindings = <&key_repeat>;
      max-prior-idle-ms = <1200>;
      strict-modifiers;
    };)


/* Nav cluster */

/* Caps-word, num-word and smart-mouse */

// tap: sticky-shift | shift + tap/ double-tap: caps-word | hold: shift
ZMK_MOD_MORPH(smart_shft,
    bindings = <&sk LSHFT>, <&caps_word>;
    mods = <(MOD_RSFT)>;
)

ZMK_MOD_MORPH(hmr_sshft,
    bindings = <&kp RSHFT>, <&caps_word>;
    mods = <(MOD_LSFT)>;
)

/* &caps_word {  // mods deactivate caps-word, requires PR #1451 */
/*     /delete-property/ ignore-modifiers; */
/*     continue-list = <UNDERSCORE MINUS>; */
/* }; */


&num_word {
  continue-list = <UNDERSCORE BSPC DEL DOT COMMA PLUS MINUS STAR FSLH EQUAL RSHFT LEFT RIGHT UP DOWN F7 F9 COLON>;
};

&sk {
    release-after-ms = <3000>;
    quick-release;
};

// smart-mouse, requires PR #1366
ZMK_TRI_STATE(
    smart_mouse, bindings = <&tog MOUSE>, <&none>, <&tog MOUSE>;
    ignored-key-positions =
        <LT1 LT3 LM1 LM2 LM3 LM4 LH0 LH1 RT0 RT1 RT2 RT3 RT4 RM0 RM1 RM2 RM3 RM4 RB1 RB2 RB3 RH0 RH1>;
    ignored-layers = <MOUSE NAV FN>;)

// smart-fn, requires PR #1366
ZMK_TRI_STATE(
    smart_fn, bindings = <&tog FN>, <&none>, <&tog FN>;
    ignored-key-positions =
        <LT1 LT2 LT3 LM1 LM2 LM3 LM4 LH0 LH1 RT0 RT1 RT2 RT3 RT4 RM0 RM1 RM2 RM3 RM4 RB1 RB2 RB3 RH0 RH1>;
    ignored-layers = <MOUSE NAV FN>;)

// smart-nav, requires PR #1366
ZMK_TRI_STATE(
    smart_nav, bindings = <&tog NAV>, <&none>, <&tog NAV>;
    ignored-key-positions =
        <LT0 LT1 LT2 LT3 LT4 LM0 LM1 LM2 LM3 LM4 LB0 LB1 LB2 LB3 LB4 RT0 RT1 RT2 RT3 RT4 RM0 RM1 RM2 RM3 RM4 RB0 RB1 RB2 RB3 RB4 RH0>;
    ignored-layers = <MOUSE NAV FN>;)
/* Custom behaviors */


// reuse basic mod-morph scheme
#define SIMPLE_MORPH(NAME, MOD, BINDING1, BINDING2) \
    ZMK_MOD_MORPH(NAME, \
        mods = <(MOD_L ## MOD|MOD_R ## MOD)>; \
        bindings = <BINDING1>, <BINDING2>; \
    )

// tap: enter | hold: num-layer | ctrl + hold: num_word
#define SMART_NUM &smart_num NUM 0
ZMK_HOLD_TAP(smart_num,
    flavor = "balanced";
    tapping-term-ms = <200>;
    quick-tap-ms = <QUICK_TAP_MS>;
    bindings = <&mo>, <&num_morph>;
)
SIMPLE_MORPH(num_morph, CTL, &kp RET, &num_word NUM)
ZMK_TAP_DANCE(num_gui,
    tapping-term-ms = <200>;
    bindings = <&kp RET>, <&sk LGUI>;
)

// tap: comma | shift + tap: semicolon | ctrl + shift + tap: <
#define SMART_COMMA &smart_comma SEMICOLON 0
ZMK_HOLD_TAP(smart_comma,
    flavor = "tap-preferred";
    tapping-term-ms = <200>;
    quick-tap-ms = <QUICK_TAP_MS>;
    bindings = <&kp>, <&comma_morph>;
)
SIMPLE_MORPH(comma_morph, SFT, &kp COMMA, &kp LESS_THAN)
// SIMPLE_MORPH(comma_inner_morph, CTL, &kp SEMICOLON, &kp LESS_THAN)

// tap: dot | shift + tap: colon | ctrl + shift + tap: >
#define SMART_DOT &smart_dot COLON 0
ZMK_HOLD_TAP(smart_dot,
    flavor = "tap-preferred";
    tapping-term-ms = <200>;
    quick-tap-ms = <QUICK_TAP_MS>;
    bindings = <&kp>, <&dot_morph>;
)
SIMPLE_MORPH(dot_morph, SFT, &kp DOT, &kp GREATER_THAN)
// SIMPLE_MORPH(dot_inner_morph, CTL, &kp COLON, &kp GREATER_THAN)

// tap: excl | shift + tap: qmark
SIMPLE_MORPH(qexcl, SFT, &kp EXCL, &kp QMARK)

// tap: left/right parenthesis | shft + tap: less-than/greater-than
SIMPLE_MORPH(lpar_lt, SFT, &kp LPAR, &kp LT)
SIMPLE_MORPH(rpar_gt, SFT, &kp RPAR, &kp GT)


// tap: copy | double-tap: cut
ZMK_TAP_DANCE(copy_cut,
    tapping-term-ms = <200>;
    bindings = <&kp LG(C)>, <&kp LG(X)>;
)

// tap: q | hold / double-tap: esc                                                                                                
ZMK_HOLD_TAP(q_esc,
    flavor = "hold-preferred";
    tapping-term-ms = <200>;
    quick-tap-ms = <QUICK_TAP_MS>;
    bindings = <&kp>, <&q_esc_taps>;
)
ZMK_TAP_DANCE(q_esc_taps,
    tapping-term-ms = <250>;
    bindings = <&kp Q>, <&kp ESC>;
)

// tap: LBRC | double-tap: RBRC
ZMK_TAP_DANCE(braces,
    tapping-term-ms = <250>;
    bindings = <&kp LBRC>, <&kp RBRC>;
)

// tap: Paste | double-tap: paste buffer
ZMK_TAP_DANCE(paste_buff,
    tapping-term-ms = <250>;
    bindings = <&kp LG(V)>, <&kp LA(LS(SPACE))>;
)

// hold: LGUI | tap: raycast | shift-tap: aerospace switcher | double-tap: sticky LGUI
ZMK_HOLD_TAP(ray_switch,
    flavor = "hold-preferred";
    hold-while-undecided;
    hold-while-undecided-linger;
    tapping-term-ms = <250>;
    quick-tap-ms = <QUICK_TAP_MS>;
    bindings = <&kp>, <&ray_switch_dance>;
)
ZMK_TAP_DANCE(ray_switch_dance,
    tapping-term-ms = <200>;
    bindings = <&ray_morph>, <&sk LGUI>;
)
SIMPLE_MORPH(ray_morph, SFT, &kp LC(SPACE), &kp LA(LS(SPACE)))

ZMK_HOLD_TAP(f12_alt_meh,
    flavor = "hold-preferred";
    hold-while-undecided;
    hold-while-undecided-linger;
    tapping-term-ms = <250>;
    quick-tap-ms = <QUICK_TAP_MS>;
    bindings = <&mo>, <&f12_alt_meh_dance>;
)
ZMK_TAP_DANCE(f12_alt_meh_dance,
    tapping-term-ms = <200>;
    bindings = <&alt_morph>, <&sk LSHFT>;
)
SIMPLE_MORPH(alt_morph, GUI, &kp F12, &sft_sft)

ZMK_MACRO(sft_sft,
    wait-ms = <20>;
    tap-ms = <20>;
    bindings = <&kp LSHFT &kp LSHFT>;
)

ZMK_HOLD_TAP(fn_tab_shift,
    flavor = "balanced";
    tapping-term-ms = <280>;
    quick-tap-ms = <QUICK_TAP_MS>;
    bindings = <&kp>, <&fn_shift>;
)
ZMK_TAP_DANCE(fn_shift,
    tapping-term-ms = <250>;
    bindings = <&kp TAB>, <&mo FN>;
)

ZMK_HOLD_TAP(kp_kp_hold,
    flavor = "hold-preferred";
    tapping-term-ms = <200>;
    quick-tap-ms = <QUICK_TAP_MS>;
    bindings = <&kp>, <&kp>;
    //hold-while-undecided;
)

ZMK_HOLD_TAP(kp_kp,
    flavor = "balanced";
    tapping-term-ms = <200>;
    quick-tap-ms = <QUICK_TAP_MS>;
    bindings = <&kp>, <&kp>;
    hold-while-undecided;
)

ZMK_HOLD_TAP(mo_kp,
    flavor = "balanced";
    tapping-term-ms = <200>;
    quick-tap-ms = <QUICK_TAP_MS>;
    bindings = <&mo>, <&kp>;
)

ZMK_HOLD_TAP(outer_left,
    flavor = "balanced";
    tapping-term-ms = <250>;
    quick-tap-ms = <QUICK_TAP_MS>;
    bindings = <&kp>, <&outer_left_tap>;
)
ZMK_TAP_DANCE(outer_left_tap,
    tapping-term-ms = <280>;
    bindings = <&kp LG(LBKT)>, <&smart_mouse>;
)

ZMK_HOLD_TAP(outer_right,
    flavor = "balanced";
    tapping-term-ms = <250>;
    quick-tap-ms = <QUICK_TAP_MS>;
    bindings = <&kp>, <&outer_right_tap>;
)
ZMK_TAP_DANCE(outer_right_tap,
    tapping-term-ms = <280>;
    bindings = <&kp LG(RBKT)>, <&caps_word>;
)


ZMK_HOLD_TAP(shift_bkp_sticky,
    flavor = "balanced";
    tapping-term-ms = <250>;
    quick-tap-ms = <QUICK_TAP_MS>;
    bindings = <&kp>, <&shift_tap>;
)
ZMK_TAP_DANCE(shift_tap,
    tapping-term-ms = <200>;
    bindings = <&kp BSPC>, <&caps_word>;
)
ZMK_HOLD_TAP(sft_nav_spc,
    flavor = "balanced";
    tapping-term-ms = <200>;
    quick-tap-ms = <QUICK_TAP_MS>;
    bindings = <&mo>, <&ak_space>;
)
ZMK_TAP_DANCE(sft_nav_spc_tap,
    tapping-term-ms = <225>;
    bindings = <&kp SPACE>, <&spc_morph>;
)
SIMPLE_MORPH(spc_morph, SFT, &spc_sft, &dot_spc)
ZMK_MACRO(spc_sft,
    wait-ms = <0>;
    tap-ms = <5>;
    bindings = <&kp SPACE &sk LSHFT>;
)
ZMK_MACRO(dot_spc,
    wait-ms = <20>;
    tap-ms = <20>;
    bindings = <&kp DOT &kp SPACE &sk LSHFT>;
)

ZMK_ADAPTIVE_KEY(ak_space,
    bindings = <&kp SPACE>;
    akt_sentence { trigger-keys = <EXCL RS(SLASH) LS(SLASH) QMARK DOT HASH MINUS>;
    bindings = <&kp SPACE &sk LSHFT>;
    };
)

// misc aliases
#define CANCEL          &kp K_CANCEL             // cancel caps-word, num-word and smart-mouse
#define DSK_PREV        &kp LS(LA(LG(LC(TAB))))  // previous desktop
#define DSK_NEXT        &hmr LGUI LA(LG(LC(TAB)))  // next     desktop
#define AS(keycode)     &as LS(keycode) keycode
#define C_NV(keycode)   &c_nv NAV keycode
#define GRID            &kp LC(LG(LA(G)))
#define HINT            &kp LG(LA(H))
#define ESC_SWITCH_COPY &esc_switch_copy RG(LC(LALT)) 0
#define RAY_SWITCH      &ray_switch LGUI 0
#define FN_TAB          &mo_kp FN TAB
#define Q_EXCL_SLSH     &q_excl_slsh QMARK 0
//#define SYM_DEL         &shift_bkp_sticky LSHFT BSPC
//#define SYM_DEL         &mo_kp MOUSE BSPC
#define SYM_DEL         &kp_kp_hold LSHFT BSPC
#define HMR_J_SSHFT     &s_hmr 0 J
#define OUTER_LEFT      &outer_left LCTRL 0
#define OUTER_RIGHT     &outer_right LALT 0
#define Q_ESC           &q_esc ESC 0
#define F12_ALT_MEH     &f12_alt_meh SYM 0
#define Q_EXC_F1        &q_esc ESC 0
// #define SFT_NAV_SPC     &sft_nav_spc LSHFT SPACE
#define SFT_NAV_SPC     &sft_nav_spc NAV SPACE

// qwerty numeric auto-shifts
#define Q_ASN_X &asn N1 X
#define Q_ASN_C &asn N2 C
#define Q_ASN_V &asn N3 V
#define Q_ASN_S &asn N4 S
#define Q_ASN_D &asn N5 D
#define Q_ASN_F &asn N6 F
#define Q_ASN_W &asn N7 W
#define Q_ASN_E &asn N8 E
#define Q_ASN_R &asn N9 R


// Utility shortcuts
#define NP_TODAY_TASK &kp LC(LA(LG(T)))
#define NP_ADD_TASK &kp LC(LA(LG(N)))
/* Keymap */

// ZMK_CONDITIONAL_LAYER(Sys,NAV NUM, SYS)  // NAV + NUM --> SYS
// ZMK_CONDITIONAL_LAYER(Aero,NAV FN, AERO)  // NAV + FN --> AERO


#ifndef ZMK_BASE_LAYER
  #define ZMK_BASE_LAYER(name, LT, RT, LM, RM, LB, RB, LH, RH)                 \
      ZMK_LAYER(name, LT RT LM RM LB RB LH RH)
#endif

#include "homerow_autoshift.dtsi"
#include "qwerty.dtsi"
// #include "niro.dtsi"


ZMK_BASE_LAYER(Sym,
//╭─────────────┬─────────────┬─────────────┬─────────────┬─────────────╮ ╭─────────────┬─────────────┬─────────────┬─────────────┬─────────────╮
      &kp PIPE    &kp AMPS       &kp ASTRK    &kp PIPE       &kp PRCNT  ,    &kp PG_DN      &kp HOME      &kp UP        &kp END      &kp PG_UP  , 
//├─────────────┼─────────────┼─────────────┼─────────────┼─────────────┤ ├─────────────┼─────────────┼─────────────┼─────────────┼─────────────┤
      &kp LGUI    &kp DLLR       &kp PRCNT    &kp CARET      &kp PLUS   ,   &kp LG(LBKT)    &kp LEFT      &kp DOWN      &kp RIGHT  &kp LG(RBKT) ,
//├─────────────┼─────────────┼─────────────┼─────────────┼─────────────┤ ├─────────────┼─────────────┼─────────────┼─────────────┼─────────────┤
      &kp LBKT     &qexcl        &kp AT       &kp HASH       &kp RBKT   ,  &kp LS(LG(Z))    &u_left       &braces       &u_right     &kp LG(Z)  ,
//╰─────────────┼─────────────┴─────────────┼─────────────┼─────────────┤ ├─────────────┼─────────────┼─────────────┴───────────────────────────╯
                                              &kp LPAR       &kp RPAR   ,    ___                                                         
//                                          ╰─────────────┴─────────────╯ ╰─────────────┴─────────────╯                                          
)

ZMK_BASE_LAYER(Num,
//╭─────────────┬─────────────┬─────────────┬─────────────┬─────────────╮ ╭─────────────┬─────────────┬─────────────┬─────────────┬─────────────╮
   AS(BSLH)         AS(N7)       AS(N8)         AS(N9)       AS(N5)     ,    &kp MINUS      &kp F7       ___          &kp F9           ___      , 
//├─────────────┼─────────────┼─────────────┼─────────────┼─────────────┤ ├─────────────┼─────────────┼─────────────┼─────────────┼─────────────┤
   ___              AS(N4)       AS(N5)         AS(N6)       AS(EQUAL)  ,    &kp UNDER     &kp RSHFT    &kp LGUI       &kp LALT    &kp LCTRL    ,  
//├─────────────┼─────────────┼─────────────┼─────────────┼─────────────┤ ├─────────────┼─────────────┼─────────────┼─────────────┼─────────────┤
   AS(GRAVE)        AS(N1)       AS(N2)         AS(N3)     ___          ,    &kp PLUS      &kp RSHFT         ___            ___          ___    , 
//╰─────────────┼─────────────┴─────────────┼─────────────┼─────────────┤ ├─────────────┼─────────────┼─────────────┴───────────────────────────╯
                                                AS(N0)      ___         ,    ___           ___                                                     
//                                          ╰─────────────┴─────────────╯ ╰─────────────┴─────────────╯                                                
)

ZMK_BASE_LAYER(Fn,
//╭───────────────┬───────────────┬───────────────┬───────────────┬─────────────╮ ╭─────────────┬─────────────┬─────────────┬─────────────┬─────────────╮
   &kp F12          &kp F7           &kp F8          &kp F9         &swapper    ,    U_WH_U         U_WH_L      U_MS_U         U_WH_R      &kp C_VOL_UP ,
//├───────────────┼───────────────┼───────────────┼───────────────┼─────────────┤ ├─────────────┼─────────────┼─────────────┼─────────────┼─────────────┤
   &kp F11         &kp F4          &kp F5           &kp F6          &kp F14    ,     U_WH_D         U_MS_L      U_MS_D         U_MS_R       &kp C_VOL_DN ,
//├───────────────┼───────────────┼───────────────┼───────────────┼─────────────┤ ├─────────────┼─────────────┼─────────────┼─────────────┼─────────────┤
   &kp F10         &kp F1             &kp F2           &kp F3       &kp F15    ,   &kp F13       &mkp LCLK     &mkp MCLK      &mkp RCLK &mkp LC(LG(LCLK)),
//╰───────────────┼───────────────┴───────────────┼───────────────┼─────────────┤ ├─────────────┼─────────────┼─────────────┴───────────────────────────╯
                                                          ___           ___    ,    &kp LSHFT     ___    &kp LGUI      
//                                                ╰───────────────┴─────────────╯ ╰─────────────┴─────────────╯
)

ZMK_BASE_LAYER(Sys,
//╭─────────────┬─────────────┬─────────────┬─────────────┬─────────────╮ ╭─────────────┬─────────────┬─────────────┬─────────────┬─────────────╮
                               _BT_SEL_KEYS_                            ,    &ind_con      &ind_bat         ___           ___           ___     ,
//├─────────────┼─────────────┼─────────────┼─────────────┼─────────────┤ ├─────────────┼─────────────┼─────────────┼─────────────┼─────────────┤
   ___           ___           ___           ___           &bootloader  ,    &bootloader   ___           ___           ___           ___        ,
//├─────────────┼─────────────┼─────────────┼─────────────┼─────────────┤ ├─────────────┼─────────────┼─────────────┼─────────────┼─────────────┤
   ___           ___           ___           ___           &sys_reset   ,    &sys_reset    ___           ___           ___           ___        ,
//╰─────────────┼─────────────┴─────────────┼─────────────┼─────────────┤ ├─────────────┼─────────────┼─────────────┴───────────────────────────╯
                                             ___           ___          ,    ___           ___                                                   
//                                          ╰─────────────┴─────────────╯ ╰─────────────┴─────────────╯                                          
)

ZMK_BASE_LAYER(Mouse,
//╭─────────────┬─────────────┬─────────────┬─────────────┬─────────────╮ ╭─────────────┬─────────────┬─────────────┬─────────────┬─────────────╮
    ___           ___           ___           ___           ___         ,   U_WH_U           U_WH_L      U_MS_U         U_WH_R       U_WH_U     ,
//├─────────────┼─────────────┼─────────────┼─────────────┼─────────────┤ ├─────────────┼─────────────┼─────────────┼─────────────┼─────────────┤
    &kp LCTRL      &kp LALT      &kp LGUI     &kp LSHFT     ___         ,   U_WH_D           U_MS_L      U_MS_D         U_MS_R       U_WH_D     ,
//├─────────────┼─────────────┼─────────────┼─────────────┼─────────────┤ ├─────────────┼─────────────┼─────────────┼─────────────┼─────────────┤
    ___           ___           ___           ___           ___         ,   ___            &mkp LCLK     &mkp MCLK      &mkp RCLK    ___        ,
//╰─────────────┼─────────────┴─────────────┼─────────────┼─────────────┤ ├─────────────┼─────────────┼─────────────┴───────────────────────────╯
                                              ___           ___         ,   &mkp LCLK      &mkp RCLK    &mkp LC(LG(LCLK)) 
//                                          ╰─────────────┴─────────────╯ ╰─────────────┴─────────────╯
)

ZMK_BASE_LAYER(Aero,
//╭─────────────┬─────────────┬─────────────┬─────────────┬─────────────╮ ╭─────────────┬─────────────┬───────────────┬─────────────┬─────────────╮
   &kp ESC         &kp LA(N7)     &kp LA(N8)   &kp LA(N9)   &kp LA(FSLH),  &kp LA(LS(J)) &kp LA(J)     &kp LA(LS(TAB)) &kp LA(L)     &kp LA(LC(LG(LS(J)))),
//├─────────────┼─────────────┼─────────────┼─────────────┼─────────────┤ ├─────────────┼─────────────┼───────────────┼─────────────┼─────────────┤
 &kp LC(LA(LG(N4)))  &kp LA(N4)   &kp LA(N5)  &kp_kp LA(LS(F)) LA(N6)   &kp LA(COMMA),  &kp LG(LS(K))   &kp RSHFT    &kp LGUI       &kp LALT     &kp LA(LC(LG(LS(K)))),
//├─────────────┼─────────────┼─────────────┼─────────────┼─────────────┤ ├─────────────┼─────────────┼───────────────┼─────────────┼─────────────┤
 &kp LC(LA(LG(N5)))  &kp LA(N1)  &kp LA(N2)   &kp LA(N3)     &kp LA(DOT),  &kp LA(LS(F12)) &kp LC(LA(LG(Q))) &kp LA(LC(LS(TAB))) &kp LC(LA(LG(A))) &kp LC(LA(LG(N8))),
//╰─────────────┼─────────────┴─────────────┼─────────────┼─────────────┤ ├─────────────┼─────────────┼───────────────┴───────────────────────────╯
                                              &kp LA(LS(B)) &kp LA(LS(SEMICOLON))  ,  NP_ADD_TASK    NP_TODAY_TASK                                                
//                                          ╰─────────────┴─────────────╯ ╰─────────────┴─────────────╯                                          
)



/* vim: set ft=c tw=174: */
